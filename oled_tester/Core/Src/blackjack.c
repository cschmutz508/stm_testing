/*
 * Blackjack code
 */

#include "blackjack.h"

volatile bool b1_pressed = false;
volatile bool b2_pressed = false;
volatile bool b3_pressed = false;
volatile bool b4_pressed = false;

const unsigned char BMP_home_screen [] = {
	0xff, 0xff, 0xff, 0xff, 0xff, 0xff, 0xff, 0xff, 0xff, 0xff, 0xff, 0xff, 0xff, 0xff, 0xff, 0xff,
	0xff, 0xc0, 0x00, 0x00, 0x00, 0x00, 0x00, 0x00, 0x00, 0x00, 0x00, 0x00, 0x00, 0x00, 0x03, 0xff,
	0xfe, 0x00, 0x00, 0x00, 0x00, 0x00, 0x00, 0x00, 0x00, 0x00, 0x00, 0x00, 0x00, 0x00, 0x00, 0x7f,
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	0xff, 0xff, 0xff, 0xff, 0xff, 0xff, 0xff, 0xff, 0xff, 0xff, 0xff, 0xff, 0xff, 0xff, 0xff, 0xff
};

// 'King', 3x5px
const unsigned char epd_bitmap_King [] = {
	0xa0, 0xa0, 0xa0, 0xc0, 0xa0
};
// 'Queen', 3x5px
const unsigned char epd_bitmap_Queen [] = {
	0xe0, 0xa0, 0xa0, 0xe0, 0x40
};
// 'Jack', 3x5px
const unsigned char epd_bitmap_Jack [] = {
	0xe0, 0x40, 0x40, 0x40, 0xc0
};
// 'Ten', 3x5px
const unsigned char epd_bitmap_Ten [] = {
	0xe0, 0x40, 0x40, 0x40, 0x40
};
// 'Nine', 3x5px
const unsigned char epd_bitmap_Nine [] = {
	0xe0, 0xa0, 0xe0, 0x20, 0x20
};
// 'Eight', 3x5px
const unsigned char epd_bitmap_Eight [] = {
	0xe0, 0xa0, 0xe0, 0xa0, 0xe0
};
// 'Seven', 3x5px
const unsigned char epd_bitmap_Seven [] = {
	0xe0, 0x20, 0x20, 0x40, 0x80
};
// 'Six', 3x5px
const unsigned char epd_bitmap_Six [] = {
	0xe0, 0x80, 0xe0, 0xa0, 0xe0
};
// 'Five', 3x5px
const unsigned char epd_bitmap_Five [] = {
	0xe0, 0x80, 0xc0, 0x20, 0xc0
};
// 'Four', 3x5px
const unsigned char epd_bitmap_Four [] = {
	0x80, 0xa0, 0xa0, 0xe0, 0x20
};
// 'Three', 3x5px
const unsigned char epd_bitmap_Three [] = {
	0xe0, 0x20, 0x60, 0x20, 0xc0
};
// 'Two', 3x5px
const unsigned char epd_bitmap_Two [] = {
	0x40, 0xa0, 0x20, 0x40, 0xe0
};
// 'Ace', 3x5px
const unsigned char epd_bitmap_Ace [] = {
	0x40, 0xa0, 0xa0, 0xe0, 0xa0
};
// 'Spades', 5x5px
const unsigned char epd_bitmap_Spades [] = {
	0x20, 0x70, 0xf8, 0xf8, 0x20
};
// 'Clubs', 5x5px
const unsigned char epd_bitmap_Clubs [] = {
	0x70, 0xf8, 0xf8, 0x20, 0x70
};
// 'Hearts', 5x5p
const unsigned char epd_bitmap_Hearts [] = {
	0x50, 0xf8, 0xf8, 0x70, 0x20
};
// 'Diamonds', 5x5px
const unsigned char epd_bitmap_Diamonds [] = {
	0x20, 0x70, 0x70, 0x70, 0x20
};

// Array of all bitmaps for convenience. (Total bytes used to store images in PROGMEM = 544)
const unsigned char* BMP_card_num[13] = {
	epd_bitmap_Ace,
	epd_bitmap_Two,
	epd_bitmap_Three,
	epd_bitmap_Four,
	epd_bitmap_Five,
	epd_bitmap_Six,
	epd_bitmap_Seven,
	epd_bitmap_Eight,
	epd_bitmap_Nine,
	epd_bitmap_Ten,
	epd_bitmap_Jack,
	epd_bitmap_Queen,
	epd_bitmap_King
};

const unsigned char* BMP_card_suit[4] = {
	epd_bitmap_Clubs,
	epd_bitmap_Diamonds,
	epd_bitmap_Hearts,
	epd_bitmap_Spades
};

// 'empty_card', 9x15px
const unsigned char BMP_empty_card [] = {
	0x7f, 0x00, 0x80, 0x80, 0x80, 0x80, 0x80, 0x80, 0x80, 0x80, 0x80, 0x80, 0x80, 0x80, 0x80, 0x80,
	0x80, 0x80, 0x80, 0x80, 0x80, 0x80, 0x80, 0x80, 0x80, 0x80, 0x80, 0x80, 0x7f, 0x00
};

// 'empty_table', 128x64px
const unsigned char BMP_empty_table [] = {
	0xff, 0xff, 0xff, 0xff, 0xff, 0xff, 0xff, 0xff, 0xff, 0xff, 0xff, 0xff, 0xff, 0xff, 0xff, 0xff,
	0xff, 0xc0, 0x00, 0x00, 0x00, 0x00, 0x00, 0x00, 0x00, 0x00, 0x00, 0x00, 0x00, 0x00, 0x03, 0xff,
	0xfe, 0x00, 0x00, 0x00, 0x00, 0x00, 0x00, 0x00, 0x00, 0x00, 0x00, 0x00, 0x00, 0x00, 0x00, 0x7f,
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	0xff, 0xff, 0xff, 0xff, 0xff, 0xff, 0xff, 0xff, 0xff, 0xff, 0xff, 0xff, 0xff, 0xff, 0xff, 0xff
};

// zzzzzzzzzzz
void ssd1306_CardFlip()
{
	ssd1306_Fill(Black);
	HAL_Delay(1000);

}

void bjack_init() {
	ssd1306_Fill(Black);
	ssd1306_DrawBitmap(0, 0, BMP_empty_table, 128, 64, White);
	ssd1306_DrawBitmap(13, 13, BMP_empty_card, 9, 15, White);
	ssd1306_DrawBitmap(15, 15, BMP_card_num[0], 3, 5, White);
	ssd1306_DrawBitmap(15, 22, BMP_card_suit[3], 5, 5, White);

	ssd1306_UpdateScreen();
	HAL_Delay(3000);

	ssd1306_Fill(Black);
	ssd1306_DrawBitmap(0, 0, BMP_home_screen, 128, 64, White);
	uint8_t select = 0;

	bjack_update_menu(select);
	ssd1306_UpdateScreen();
}

void bjack_home() {
	ssd1306_Fill(Black);
	ssd1306_DrawBitmap(0, 0, BMP_home_screen, 128, 64, White);
	bool loop_c = true;
	uint8_t select = 0;

	bjack_update_menu(select);
	ssd1306_UpdateScreen();

	while (loop_c) {
		__WFI();
		if (b1_pressed) {
			b1_pressed = false;
			if (!(select == 0)) {
				select--;
				bjack_update_menu(select);
				ssd1306_UpdateScreen();
			}
		}
		if (b2_pressed) {
			b2_pressed = false;
			if (!(select == 2)) {
				select++;
				bjack_update_menu(select);
				ssd1306_UpdateScreen();
			}
		}
		if (b3_pressed) {
			b3_pressed = false;
			switch(select) {
			case 0: bjack_init(); break;
			case 1: break;
			case 2: break;
			}
		}
	}
}

void bjack_update_menu(uint8_t select) {
	ssd1306_FillRectangle(42, 37, 43, 38, Black);
	ssd1306_FillRectangle(42, 45, 43, 46, Black);
	ssd1306_FillRectangle(42, 53, 43, 54, Black);

	switch (select) {
	case 0: ssd1306_FillRectangle(42, 37, 43, 38, White); break;
	case 1: ssd1306_FillRectangle(42, 45, 43, 46, White); break;
	case 2: ssd1306_FillRectangle(42, 53, 43, 54, White); break;
	}

	ssd1306_UpdateScreen();
}

/*
 *
 * end space
 *
 *
 */
